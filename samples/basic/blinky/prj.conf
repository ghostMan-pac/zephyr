## CMakeLists.txt
```
cmake_minimum_required(VERSION 3.20.0)
find_package(Zephyr REQUIRED HINTS $ENV{ZEPHYR_BASE})
project(motor_ble)
target_sources(app PRIVATE src/main.c src/motor.c src/ble_service.c)
```

## prj.conf
```kconfig
# Bluetooth
CONFIG_BT=y
CONFIG_BT_PERIPHERAL=y
CONFIG_BT_DEVICE_NAME="MotorBot"
CONFIG_BT_MAX_CONN=1



# PWM via LEDC
CONFIG_PWM=y

# Logging
CONFIG_LOG=y
CONFIG_LOG_DEFAULT_LEVEL=3

# Stack sizes — ESP32-S3 BLE needs generous stacks
CONFIG_MAIN_STACK_SIZE=4096
CONFIG_BT_RX_STACK_SIZE=4096
CONFIG_SYSTEM_WORKQUEUE_STACK_SIZE=2048
CONFIG_BT_HCI_TX_STACK_SIZE=2048
```

## app.overlay
```dts
// / {
//     aliases {
//         motor-left  = &pwm_left;
//         motor-right = &pwm_right;
//     };
// };

// &ledc0 {
//     status = "okay";
//     #pwm-cells = <3>;

//     pwm_left: pwm_left {
// 	reg = <0 12>;
//         timer = <0>;
//         channel = <0>;
//         pin = <18>;   /* GPIO18 → left motor */
//     };
//     pwm_right: pwm_right {
// 	reg = <0 12>;
//         timer = <1>;
//         channel = <1>;
//         pin = <19>;   /* GPIO19 → right motor */
//     };
// };
```

## boards/sam_e54_xpro.overlay
```dts
/*
 * Copyright (C) 2026 Microchip Technology Inc. and its subsidiaries
 *
 * SPDX-License-Identifier: Apache-2.0
 *
 */
/ {
	aliases {
		evsys0 = &evsys;
	};
};
```

## src/main.c
```c
/*
 * Copyright (c) 2016 Intel Corporation
 *
 * SPDX-License-Identifier: Apache-2.0
 */

#include <stdio.h>
#include <zephyr/kernel.h>
#include <zephyr/drivers/gpio.h>
#include <zephyr/drivers/misc/mchp_evsys/mchp_evsys_g1.h>
#include <soc.h>

/* 1000 msec = 1 sec */
#define SLEEP_TIME_MS 1000

/* The devicetree node identifier for the "led0" alias. */
#define LED1_NODE DT_ALIAS(led1)
#define LED0_NODE DT_ALIAS(led0)
#define SW0_NODE  DT_ALIAS(sw0)

/*
 * A build error on this line means your board is unsupported.
 * See the sample documentation for information on how to fix this.
 */
const struct device *evsys_dev = DEVICE_DT_GET(DT_ALIAS(evsys0));
static const struct gpio_dt_spec led1 = GPIO_DT_SPEC_GET(LED1_NODE, gpios);

static const struct gpio_dt_spec led = GPIO_DT_SPEC_GET(LED0_NODE, gpios);
static const struct gpio_dt_spec button = GPIO_DT_SPEC_GET(SW0_NODE, gpios);

int main()
{

	int ret;
	bool led_state = true;

	if (!gpio_is_ready_dt(&button)) {
		return 0;
	}

	ret = gpio_pin_configure_dt(&button, GPIO_INPUT);
	if (ret < 0) {
		return 0;
	}
	ret = gpio_pin_interrupt_configure_dt(&button, GPIO_INT_EDGE_TO_ACTIVE);
	if (ret != 0) {
		printk("Error %d: failed to configure interrupt on %s pin %d\n", ret,
		       button.port->name, button.pin);
		return 0;
	}

	if (!gpio_is_ready_dt(&led)) {
		return 0;
	}

	ret = gpio_pin_configure_dt(&led, GPIO_OUTPUT_ACTIVE);
	if (ret < 0) {
		return 0;
	}

	ret = gpio_pin_configure_dt(&led1, GPIO_OUTPUT_ACTIVE);
	if (ret < 0) {
		return 0;
	}

	// uint8_t channel_num = 0; // channel number should be requested in pilkaalam
	// evsys_mchp_connect_user_to_channel(evsys_dev, channel_num, EVSYS_MCHP_EVUSER_PORT_EV0);
	// evsys_mchp_connect_channel_to_evgen(evsys_dev, channel_num, EVSYS_MCHP_EVGEN_EIC_EXTINT15);

	while (1) {
	};
	return 0;
}
```

## src/ble_service.c
```c
#include <zephyr/bluetooth/bluetooth.h>
#include <zephyr/bluetooth/gatt.h>
#include <zephyr/bluetooth/gap.h>
#include <zephyr/logging/log.h>
#include "motor.h"

LOG_MODULE_REGISTER(ble_svc);

#define BT_UUID_MOTOR_SVC_VAL BT_UUID_128_ENCODE(0x12345678, 0x1234, 0x5678, 0x1234, 0x56789abcdef0)
#define BT_UUID_MOTOR_CMD_VAL BT_UUID_128_ENCODE(0x12345678, 0x1234, 0x5678, 0x1234, 0x56789abcdef1)

static struct bt_uuid_128 motor_svc_uuid = BT_UUID_INIT_128(BT_UUID_MOTOR_SVC_VAL);
static struct bt_uuid_128 motor_cmd_uuid = BT_UUID_INIT_128(BT_UUID_MOTOR_CMD_VAL);

static ssize_t write_motor_cmd(struct bt_conn *conn, const struct bt_gatt_attr *attr,
			       const void *buf, uint16_t len, uint16_t offset, uint8_t flags)
{
	if (len != 1) {
		return BT_GATT_ERR(BT_ATT_ERR_INVALID_ATTRIBUTE_LEN);
	}

	uint8_t cmd = ((uint8_t *)buf)[0];
	LOG_INF("Motor cmd: 0x%02X", cmd);

	switch (cmd) {
	case 0x01:
		motor_forward();
		break;
	case 0x02:
		motor_backward();
		break;
	case 0x03:
		motor_turn_left();
		break;
	case 0x04:
		motor_turn_right();
		break;
	default:
		motor_stop();
		break;
	}
	return len;
}

BT_GATT_SERVICE_DEFINE(motor_svc, BT_GATT_PRIMARY_SERVICE(&motor_svc_uuid),
		       BT_GATT_CHARACTERISTIC(&motor_cmd_uuid.uuid, BT_GATT_CHRC_WRITE_WITHOUT_RESP,
					      BT_GATT_PERM_WRITE, NULL, write_motor_cmd, NULL), );

static const struct bt_data ad[] = {
	BT_DATA_BYTES(BT_DATA_FLAGS, (BT_LE_AD_GENERAL | BT_LE_AD_NO_BREDR)),
	BT_DATA(BT_DATA_NAME_COMPLETE, CONFIG_BT_DEVICE_NAME, sizeof(CONFIG_BT_DEVICE_NAME) - 1),
};

static void connected(struct bt_conn *conn, uint8_t err)
{
	if (err) {
		LOG_ERR("Connection failed, err 0x%02X", err);
	} else {
		LOG_INF("Connected");
	}
}

static void disconnected(struct bt_conn *conn, uint8_t reason)
{
	LOG_INF("Disconnected, reason 0x%02X", reason);
	bt_le_adv_start(BT_LE_ADV_CONN_FAST_2, ad, ARRAY_SIZE(ad), NULL, 0);
}

BT_CONN_CB_DEFINE(conn_callbacks) = {
	.connected = connected,
	.disconnected = disconnected,
};

void ble_service_init(void)
{
	int err;

	err = bt_enable(NULL);
	if (err) {
		LOG_ERR("Bluetooth init failed: %d", err);
		return;
	}

	err = bt_le_adv_start(BT_LE_ADV_CONN_FAST_2, ad, ARRAY_SIZE(ad), NULL, 0);
	if (err) {
		LOG_ERR("Advertising failed to start: %d", err);
		return;
	}

	LOG_INF("BLE advertising started as '%s'", CONFIG_BT_DEVICE_NAME);
}
```

## src/ble_service.h
```c
#ifndef BLE_SERVICE_H
#define BLE_SERVICE_H

void ble_service_init(void);

#endif /* BLE_SERVICE_H */
```

## src/motor.c
```c
#include <zephyr/kernel.h>
#include <zephyr/drivers/pwm.h>
#include "motor.h"

/* Adjust these to your actual DTS PWM nodes */
static const struct pwm_dt_spec motor_left = {0};  // PWM_DT_SPEC_GET(DT_ALIAS(motor_left));
static const struct pwm_dt_spec motor_right = {0}; // PWM_DT_SPEC_GET(DT_ALIAS(motor_right));

#define PERIOD_NS 20000000U /* 50 Hz */
#define FULL_FWD  (PERIOD_NS)
#define FULL_REV  0
#define HALF      (PERIOD_NS / 2)

void motor_init(void)
{
	/* PWM devices are ready-checked in main */
}

static void set_motors(uint32_t left_pw, uint32_t right_pw)
{
	pwm_set_dt(&motor_left, PERIOD_NS, left_pw);
	pwm_set_dt(&motor_right, PERIOD_NS, right_pw);
}

void motor_forward(void)
{
	printf("Moving Forward\n");
}
void motor_backward(void)
{
	printf("Moving Back\n");
}
void motor_turn_left(void)
{
	printf("Moving Left\n");
}
void motor_turn_right(void)
{
	printf("Moving Right\n");
}
void motor_stop(void)
{
	printf("Moving Stopped\n");
}
```

## src/motor.h
```c
#ifndef MOTOR_H
#define MOTOR_H

void motor_init(void);
void motor_forward(void);
void motor_backward(void);
void motor_turn_left(void);
void motor_turn_right(void);
void motor_stop(void);

#endif
```
